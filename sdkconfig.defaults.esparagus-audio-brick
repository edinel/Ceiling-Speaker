## sdkconfig.defaults.esparagus-audio-brick
```kconfig
# Esparagus Audio Brick defaults
CONFIG_BOARD_ESPARAGUS_AUDIO_BRICK=y
CONFIG_ESPTOOLPY_FLASHSIZE_8MB=y
CONFIG_ESPTOOLPY_FLASHSIZE="8MB"
CONFIG_DAC_TAS58XX=y
CONFIG_DAC_CONTROLS_VOLUME=y
```

## sdkconfig.defaults.secrets.example
```kconfig
# Copy this file to sdkconfig.defaults.secrets and fill in your values.
# sdkconfig.defaults.secrets is gitignored and will never be committed.
CONFIG_DEFAULT_WIFI_SSID="your-ssid-here"
CONFIG_DEFAULT_WIFI_PASSWORD="your-password-here"
```

## sdkconfig.defaults.xiao-esp32s3
```kconfig
# Seeed XIAO ESP32-S3 (ESP32-S3R8: QIO flash + OPI PSRAM)
# Loaded after sdkconfig.defaults and sdkconfig.defaults.esp32s3.
# The chip has 8MB OPI PSRAM that must remain enabled — disabling SPIRAM
# leaves the MSPI bus unconfigured and causes init_flash to assert.

CONFIG_BOARD_ESP32S3_GENERIC=y
CONFIG_ESPTOOLPY_FLASHSIZE_8MB=y
CONFIG_ESPTOOLPY_FLASHSIZE="8MB"

# USB CDC console — XIAO has no USB-to-serial chip
CONFIG_ESP_CONSOLE_USB_CDC=y

# I2S pins: BCK=GPIO4(D3), DIN=GPIO5(D4), WSEL=GPIO6(D5)
CONFIG_I2S_SCK_IO=-1
CONFIG_I2S_BCK_IO=4
CONFIG_I2S_WS_IO=6
CONFIG_I2S_DO_IO=5

# Hardware not present on XIAO
CONFIG_BAT_CHANNEL=-1
CONFIG_LED_RGB_GPIO=-1
```
